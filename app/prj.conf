## CMakeLists.txt
```
cmake_minimum_required(VERSION 3.20.0)
find_package(Zephyr REQUIRED HINTS $ENV{ZEPHYR_BASE})
project(stm32_test_app)

target_include_directories(app PRIVATE
    ${CMAKE_CURRENT_SOURCE_DIR}/include
)


target_sources(app PRIVATE
    src/main.c
    src/buttons/buttons.c
    src/os/threads.c
    src/services/system_service.c
)
```

## prj.conf
```kconfig
CONFIG_SERIAL=y
CONFIG_CONSOLE=y
CONFIG_UART_CONSOLE=y
CONFIG_PRINTK=y
CONFIG_GPIO=y
CONFIG_PM=n
CONFIG_THREAD_NAME=y
```

## boards/stm32l4r9i_disco.overlay
```dts
/ {
    chosen {
        zephyr,console = &usart2;
        zephyr,shell-uart = &usart2;
    };
};

&usart2 {
    status = "okay";
    current-speed = <115200>;
};
```

## src/main.c
```c
#include <zephyr/kernel.h>
#include <zephyr/sys/printk.h>
#include "app_api.h"

void main(void)
{
    printk("[app] startup\n");

    system_service_init();
    threads_start();
    button_init();

    while (1) {
        printk("[main]:uptime: %llu ms\n", k_uptime_get());
        k_sleep(K_MSEC(500));
    }
}
```

## include/app_api.h
```c
#ifndef APP_API_H
#define APP_API_H

void system_service_init(void);
void threads_start(void);
int button_init(void);

#endif /* APP_API_H */
```
